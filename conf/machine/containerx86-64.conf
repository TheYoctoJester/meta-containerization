## conf/machine/containerx86-64.conf
```bitbake
#@TYPE: Machine
#@NAME: Container X86_64.

#@DESCRIPTION: Machine configuration for generic X86_64 (64-bit) containers. Does not include a kernel!

DEFAULTTUNE ?= "core2-64"
require conf/machine/include/tune-core2.inc

PREFERRED_PROVIDER_virtual/kernel ?= "linux-dummy"

IMAGE_TYPE = "container"
```
